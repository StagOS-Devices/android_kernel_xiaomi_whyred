## arch/arm64/hotplug/Kconfig
```kconfig
menu "Custom Hotplug drivers"

config CUSTOM_HOTPLUG
	bool "Enable custom hotplug support"

config AUTOSMP
	bool "Multi-core automatic hotplug support"
	depends on SMP && HOTPLUG_CPU
	default n
	help
	  Automatically hotplugs the multiple cpu cores on and off
	  based on cpu load and suspend state.

endmenu
```
